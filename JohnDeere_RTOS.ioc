# file: JohnDeere_RTOS.ioc
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FREERTOS.Tasks01=defaultTask,0,128,StartDefaultTask,Default,NULL,Dynamic,NULL,NULL
FREERTOS.configUSE_NEWLIB_REENTRANT=1
Mcu.Family=STM32F1
Mcu.Name=STM32F103R(8-B)Tx
Mcu.Package=LQFP64
NVIC.PriorityGroup=NVIC_PRIORITYGROUP_4
NVIC.TIM4_IRQn=true\:15\:0\:false\:false\:true\:false\:false\:true\:true
NVIC.TimeBase=TIM4_IRQn
NVIC.TimeBaseIP=TIM4
PA13.GPIO_Label=TMS
PA13.Mode=Serial_Wire
PA13.Signal=SYS_JTMS-SWDIO
PA14.GPIO_Label=TCK
PA14.Mode=Serial_Wire
PA14.Signal=SYS_JTCK-SWCLK
PB3.GPIO_Label=SWO
PB3.Signal=SYS_JTDO-TRACESWO
ProjectManager.HeapSize=0x200
ProjectManager.StackSize=0x400
ProjectManager.TargetToolchain=CMake
RCC.AHBFreq_Value=64000000
RCC.APB1CLKDivider=RCC_HCLK_DIV2
RCC.APB1Freq_Value=32000000
RCC.APB1TimFreq_Value=64000000
RCC.APB2Freq_Value=64000000
RCC.APB2TimFreq_Value=64000000
RCC.HCLKFreq_Value=64000000
RCC.PLLMUL=RCC_PLL_MUL16
RCC.SYSCLKFreq_VALUE=64000000
RCC.SYSCLKSource=RCC_SYSCLKSOURCE_PLLCLK
RCC.USBFreq_Value=64000000
VP_FREERTOS_VS_CMSIS_V1.Mode=CMSIS_V1
VP_SYS_VS_tim4.Mode=TIM4
board=NUCLEO-F103RB

// file: Core/Src/main.c
/* USER CODE BEGIN Header */
/**
  ******************************************************************************
  * @file           : main.c
  * @brief          : Main program body for FreeRTOS application
  ******************************************************************************
  * @attention
  *
  * Copyright (c) 2026 STMicroelectronics.
  * All rights reserved.
  *
  * This software is licensed under terms that can be found in the LICENSE file
  * in the root directory of this software component.
  * If no LICENSE file comes with this software, it is provided AS-IS.
  *
  ******************************************************************************
  */
/* USER CODE END Header */
#include "main.h"
#include "FreeRTOS.h"
#include "task.h"

#include "lcd.h"
#include "delay.h"
#include "system_clock.h"
#include "gpio.h"
#include "usart.h"
#include "adc.h"
#include "tim2.h"
#include "tim3.h"
#include "brake.h"
#include "EngTrModel.h"

void MX_FREERTOS_Init(void);
static void MX_Peripherals_Init(void);

int main(void)
{
  /* MCU Configuration--------------------------------------------------------*/

  /* Reset of all peripherals, Initializes the Flash interface and the Systick. */
  HAL_Init();

  /* Configure the system clock */
  USER_SystemClock_Config();

  /* Initialize all configured peripherals and application modules */
  MX_Peripherals_Init();

  /* Initialize the transmission model */
  EngTrModel_initialize();

  /* Call init function for freertos objects (in freertos.c) */
  MX_FREERTOS_Init();

  /* Start scheduler */
  vTaskStartScheduler();

  /* We should never get here as control is now taken by the scheduler */
  while (1)
  {
  }
}

/**
  * @brief  Initialize peripherals and application modules.
  * @retval None
  */
static void MX_Peripherals_Init(void)
{
  USER_GPIO_Init();
  USER_USART_Init();
  USER_USART_SendString("HELLO_FROM_STM32_PA9\r\n");
  USER_TIM2_Init();
  USER_TIM3_Init();

  /* Wait for LCD power stabilization (>500ms) */
  for (int i = 0; i < 500; i++)
  {
    USER_TIM_Delay_1ms();
  }

  LCD_Init();
  USER_USART_SendString("DBG: LCD_Init done\r\n");

  /* Initial LCD display */
  LCD_Clear();
  LCD_Set_Cursor(1, 1);
  LCD_Put_Str("RPM:    V:  ");
  LCD_Set_Cursor(2, 1);
  LCD_Put_Str("G:1 A:0% B:0");
  USER_USART_SendString("DBG: LCD text written\r\n");
}

void Error_Handler(void)
{
  __disable_irq();
  while (1)
  {
  }
}

// file: Core/Src/freertos.c
/* USER CODE BEGIN Header */
/**
  ******************************************************************************
  * File Name          : freertos.c
  * Description        : Code for freertos applications
  ******************************************************************************
  * @attention
  *
  * Copyright (c) 2026 STMicroelectronics.
  * All rights reserved.
  *
  * This software is licensed under terms that can be found in the LICENSE file
  * in the root directory of this software component.
  * If no LICENSE file comes with this software, it is provided AS-IS.
  *
  ******************************************************************************
  */
/* USER CODE END Header */

#include "FreeRTOS.h"
#include "task.h"
#include "queue.h"
#include "main.h"
#include "app_tasks.h"

/* GetIdleTaskMemory prototype (linked to static allocation support) */
void vApplicationGetIdleTaskMemory( StaticTask_t **ppxIdleTaskTCBBuffer, StackType_t **ppxIdleTaskStackBuffer, uint32_t *pulIdleTaskStackSize );

/* USER CODE BEGIN GET_IDLE_TASK_MEMORY */
static StaticTask_t xIdleTaskTCBBuffer;
static StackType_t xIdleStack[configMINIMAL_STACK_SIZE];

void vApplicationGetIdleTaskMemory( StaticTask_t **ppxIdleTaskTCBBuffer, StackType_t **ppxIdleTaskStackBuffer, uint32_t *pulIdleTaskStackSize )
{
  *ppxIdleTaskTCBBuffer = &xIdleTaskTCBBuffer;
  *ppxIdleTaskStackBuffer = &xIdleStack[0];
  *pulIdleTaskStackSize = configMINIMAL_STACK_SIZE;
}
/* USER CODE END GET_IDLE_TASK_MEMORY */

/* USER CODE BEGIN Application */

/**
  * @brief  FreeRTOS initialization
  *         Crea las Queues y las Tareas con prioridades RMS.
  * @param  None
  * @retval None
  */
void MX_FREERTOS_Init(void)
{
  /* Crear Queues para comunicacion entre tareas */
  xModelToDisplayQueue   = xQueueCreate( 1, sizeof( ModelOutput_t ) );
  xModelToTelemetryQueue = xQueueCreate( 1, sizeof( ModelOutput_t ) );
  xRemoteQueue           = xQueueCreate( 1, sizeof( RemoteCommand_t ) );

  /* Verificar que las Queues se crearon correctamente */
  if( xModelToDisplayQueue == NULL || xModelToTelemetryQueue == NULL ||
      xRemoteQueue == NULL )
  {
    /* Error en creacion de queues - bloquear */
    for( ;; );
  }

  /* Crear Tareas Periodicas con calendarizacion RMS
   * Periodo mas corto => Prioridad mas alta
   */

  /* Tarea RemoteControl: Periodo 50 ms, Prioridad 4 (maxima) */
  xTaskCreate( vTaskRemoteControl,
               "Remote",
               STACK_REMOTE,
               NULL,
               TASK_REMOTE_PRIO,
               NULL );

  /* Tarea ModelControl: Periodo 40 ms, Prioridad 3 */
  xTaskCreate( vTaskModelControl,
               "ModelCtrl",
               STACK_MODEL,
               NULL,
               TASK_MODEL_PRIO,
               NULL );

  /* Tarea Telemetry: Periodo 100 ms, Prioridad 2 */
  xTaskCreate( vTaskTelemetry,
               "Telemetry",
               STACK_TELEMETRY,
               NULL,
               TASK_TELEMETRY_PRIO,
               NULL );

  /* Tarea Display: Periodo 200 ms, Prioridad 1 */
  xTaskCreate( vTaskDisplay,
               "Display",
               STACK_DISPLAY,
               NULL,
               TASK_DISPLAY_PRIO,
               NULL );
}

/* USER CODE END Application */
